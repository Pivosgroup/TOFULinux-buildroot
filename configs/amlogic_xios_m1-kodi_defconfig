## configs/amlogic_xios_m1-kodi_defconfig
```kconfig
BR2_arm=y
BR2_cortex_a9=y
BR2_ARM_EABI=y
BR2_ARM_ENABLE_NEON=y
BR2_ARM_FPU_VFPV3D16=y
BR2_ARM_AMLOGIC=y
BR2_BOARD_TYPE_AMLOGIC_M1=y
BR2_OPTIMIZE_2=y
BR2_TOOLCHAIN_EXTERNAL=y
BR2_TOOLCHAIN_EXTERNAL_CODESOURCERY_ARM2010Q1=y
BR2_TOOLCHAIN_GLIBC_GCONV_LIBS_COPY=y
BR2_PACKAGE_HOST_GDB=y
BR2_EXT_TOOL_DIRS_EXTRA="/usr/share/zoneinfo"
BR2_TARGET_GENERIC_HOSTNAME="pivos-m1"
BR2_TARGET_GENERIC_ISSUE="Welcome to Pivos M1 Linux"
BR2_TARGET_GENERIC_PASSWD_DES=y
BR2_TARGET_OPTIMIZATION="-pipe -mfloat-abi=softfp -mfpu=neon"
BR2_TARGET_GENERIC_ROOT_PASSWD="letmein"
BR2_ROOTFS_OVERLAY="board/amlogic/M1/overlay"
BR2_LINUX_KERNEL=y
BR2_LINUX_KERNEL_CUSTOM_GIT=y
BR2_LINUX_KERNEL_CUSTOM_REPO_URL="https://github.com/Pivosgroup/buildroot-linux-kernel.git"
BR2_LINUX_KERNEL_CUSTOM_REPO_VERSION="e4430d8a0b5d7d18b112b920d2fe1a4e36397f87"
BR2_LINUX_KERNEL_DEFCONFIG="meson_xios"
BR2_PACKAGE_BUSYBOX_CONFIG="board/amlogic/M1/busybox.config"
BR2_PACKAGE_BUSYBOX_SHOW_OTHERS=y
BR2_PACKAGE_ALSA_UTILS_ALSACONF=y
BR2_PACKAGE_ALSA_UTILS_AMIXER=y
BR2_PACKAGE_ALSA_UTILS_APLAY=y
BR2_PACKAGE_ALSA_UTILS_IECSET=y
BR2_PACKAGE_ALSA_UTILS_SPEAKER_TEST=y
BR2_PACKAGE_MPG123=y
BR2_PACKAGE_LIRC=y
BR2_PACKAGE_OPENGL_API9=y
BR2_PACKAGE_KODI=y
BR2_ROOTFS_DEVICE_CREATION_DYNAMIC_EUDEV=y
BR2_KODI_REMOTE_CONF="xios_ds_remote"
BR2_KODI_KEYMAP="variant.xios_m1.keyboard"
BR2_KODI_SETTINGS="xios_settings"
BR2_KODI_ADV_SETTINGS="xios_m1_advancedsettings"
BR2_KODI_SPLASH="ds.splash"
BR2_KODI_STARTING_FB="ds.starting"
BR2_KODI_STOPPING_FB="ds.shutting.down"
BR2_KODI_COMPLETE_FB="ds.shutdown.complete"
BR2_KODI_COPYING_FB="ds.copy"
BR2_KODI_REBOOTING_FB="ds.rebooting"
BR2_KODI_RSS_FEEDS="RssFeeds-ds"
BR2_KODI_POWERDOWN is not set
BR2_KODI_SUSPEND=n
BR2_KODI_REBOOT=y
BR2_KODI_SET_CONFLUENCE_POWER_BUTTON_MENU=y
BR2_KODI_NO_CONFLUENCE=y
BR2_KODI_NO_TOFU_BLUR=y
BR2_KODI_DEFAULT_SKIN="tofu"
BR2_KODI_DEFAULT_DEVICE_NAME="TOFU"
BR2_KODI_WEB_INTERFACE="tofu"
BR2_KODI_NO_DEFAULT_WEB_INTERFACE=y
BR2_PACKAGE_LZOP=y
BR2_PACKAGE_GDB=y
BR2_PACKAGE_GDB_DEBUGGER=y
BR2_PACKAGE_STRACE=y
BR2_PACKAGE_FBDUMP=y
BR2_PACKAGE_FBGRAB=y
BR2_PACKAGE_FBSET=y
BR2_PACKAGE_CIFS_UTILS=y
BR2_PACKAGE_LIBAMPLAYERM1=y
BR2_PACKAGE_MTD=y
# BR2_PACKAGE_MTD_MTD_DEBUG is not set
# BR2_PACKAGE_MTD_MTDINFO is not set
# BR2_PACKAGE_MTD_UBIATTACH is not set
# BR2_PACKAGE_MTD_UBICRC32 is not set
# BR2_PACKAGE_MTD_UBIDETACH is not set
# BR2_PACKAGE_MTD_UBIFORMAT is not set
# BR2_PACKAGE_MTD_UBIMKVOL is not set
# BR2_PACKAGE_MTD_UBINFO is not set
# BR2_PACKAGE_MTD_UBINIZE is not set
# BR2_PACKAGE_MTD_UBIRENAME is not set
# BR2_PACKAGE_MTD_UBIRMVOL is not set
# BR2_PACKAGE_MTD_UBIRSVOL is not set
# BR2_PACKAGE_MTD_UBIUPDATEVOL is not set
BR2_PACKAGE_SQUASHFS=y
BR2_PACKAGE_SQUASHFS_LZMA=y
BR2_PACKAGE_SQUASHFS_LZO=y
BR2_PACKAGE_SQUASHFS_XZ=y
BR2_PACKAGE_I2C_TOOLS=y
BR2_PACKAGE_LSUIO=y
BR2_PACKAGE_UBOOT_TOOLS=y
BR2_PACKAGE_NTFS_3G=y
BR2_PACKAGE_USBMOUNT=y
BR2_PACKAGE_UTIL_LINUX_BINARIES=y
BR2_PACKAGE_UTIL_LINUX_MOUNT=y
BR2_PACKAGE_USBUTILS=y
BR2_PACKAGE_USBUTILS_ZLIB=y
BR2_PACKAGE_LIBID3TAG=y
BR2_PACKAGE_PIXMAN=y
BR2_PACKAGE_LIBTIRPC=y
# BR2_PACKAGE_AVAHI_AUTOIPD is not set
BR2_PACKAGE_BLUEZ_UTILS=y
BR2_PACKAGE_BLUEZ_UTILS_COMPAT=y
BR2_PACKAGE_BLUEZ_UTILS_USB=y
BR2_PACKAGE_JPEG_TURBO=y
BR2_PACKAGE_DROPBEAR=y
BR2_PACKAGE_DROPBEAR_DISABLE_REVERSEDNS=y
# BR2_PACKAGE_DROPBEAR_SMALL is not set
BR2_PACKAGE_IFPLUGD=y
BR2_PACKAGE_NTP=y
BR2_PACKAGE_NTP_NTPDATE=y
BR2_PACKAGE_PROFTPD=y
BR2_PACKAGE_TCPDUMP=y
BR2_PACKAGE_TCPDUMP_SMB=y
BR2_PACKAGE_DBUS_PYTHON=y
BR2_PACKAGE_NETWORK_MANAGER=y
BR2_PACKAGE_DHCP=y
BR2_PACKAGE_DHCP_CLIENT=y
BR2_PACKAGE_WIRELESS_TOOLS=y
BR2_PACKAGE_WIRELESS_TOOLS_LIB=y
BR2_PACKAGE_WPA_SUPPLICANT=y
BR2_PACKAGE_WPA_SUPPLICANT_EAP=y
BR2_PACKAGE_WPA_SUPPLICANT_CLI=y
BR2_PACKAGE_WPA_SUPPLICANT_PASSPHRASE=y
BR2_PACKAGE_WPA_SUPPLICANT_DBUS_NEW=y
BR2_PACKAGE_WPA_SUPPLICANT_DBUS_INTROSPECTION=y
BR2_PACKAGE_WPA_SUPPLICANT_WPS=y
BR2_PACKAGE_NANO=y
# BR2_PACKAGE_NANO_TINY is not set
# BR2_TARGET_ROOTFS_TAR is not set
BR2_TARGET_TZ_INFO=y
BR2_TARGET_ROOTFS_RECOVERY_AML=y
BR2_TARGET_ROOTFS_RECOVERY_AML_BOARDNAME="stvm3"
BR2_TARGET_ROOTFS_RECOVERY_AML_UPDATE_IMG=y
BR2_TARGET_ROOTFS_RECOVERY_AML_UPDATE_ZIP_NAME_CUSTOM=y
BR2_TARGET_ROOTFS_RECOVERY_AML_UPDATE_ZIP_NAME_CUSTOM_STRING="pivos-m1"
BR2_TARGET_ROOTFS_RECOVERY_AML_ADV_MTD=y
BR2_TARGET_ROOTFS_RECOVERY_AML_ADV_FS_YAFFS2=y
BR2_TARGET_ROOTFS_RECOVERY_AML_LOGO="fs/recovery_aml/logos/pivos_logo.img"
BR2_TARGET_ROOTFS_RECOVERY_AML_ADV_PATH_LOGO="logo"
BR2_TARGET_ROOTFS_RECOVERY_AML_ADV_PATH_SYSTEM="system"
BR2_TARGET_ROOTFS_RECOVERY_AML_ADV_PATH_DATA="userdata"
```

## package/amlogic/Config.in
```kconfig
menu "AMLogic libraries and programs"
source "package/amlogic/opengl/Config.in"
source "package/amlogic/libamplayer/Config.in"
source "package/amlogic/amremote_config/Config.in"
source "package/amlogic/broadcom/Config.in"
endmenu
```

## package/amlogic/libamplayer/Config.in
```kconfig
config BR2_PACKAGE_LIBAMPLAYER
        depends on BR2_BOARD_TYPE_AMLOGIC_M6 || BR2_BOARD_TYPE_AMLOGIC_M3 || BR2_BOARD_TYPE_AMLOGIC_M1
        depends on !BR2_PACKAGE_LIBAMPLAYERM6 && !BR2_PACKAGE_LIBAMPLAYERM3 && !BR2_PACKAGE_LIBAMPLAYERM1
        bool "libamplayer"
        help
          amlogic media player library for M1/M3/M6

config BR2_PACKAGE_LIBAMPLAYER_SOURCE
	bool "source"
	help
	  Use a git or mercurial repo to build libamplayer from source.

config BR2_PACKAGE_LIBAMPLAYER_SOURCE_URL
	string "repo url"
	depends on BR2_PACKAGE_LIBAMPLAYER_SOURCE

config BR2_PACKAGE_LIBAMPLAYER_SOURCE_VERSION
	string "repo version"
	depends on BR2_PACKAGE_LIBAMPLAYER_SOURCE
```

## package/thirdparty/Config.in
```kconfig
menu "Kodi and its Dependencies"
source "package/thirdparty/giflib/Config.in"
source "package/thirdparty/librtmp/Config.in"
source "package/thirdparty/libsquish/Config.in"
source "package/thirdparty/libssh/Config.in"
source "package/thirdparty/lirc/Config.in"
source "package/thirdparty/boblight/Config.in"
source "package/thirdparty/kodi/Config.in"
source "package/thirdparty/kodi-addons/Config.in"
source "package/thirdparty/kodi-audiodecoder-modplug/Config.in"
source "package/thirdparty/kodi-audiodecoder-nosefart/Config.in"
source "package/thirdparty/kodi-audiodecoder-sidplay/Config.in"
source "package/thirdparty/kodi-audiodecoder-snesapu/Config.in"
source "package/thirdparty/kodi-audiodecoder-stsound/Config.in"
source "package/thirdparty/kodi-audiodecoder-timidity/Config.in"
source "package/thirdparty/kodi-audiodecoder-vgmstream/Config.in"
source "package/thirdparty/kodi-audioencoder-flac/Config.in"
source "package/thirdparty/kodi-audioencoder-lame/Config.in"
source "package/thirdparty/kodi-audioencoder-vorbis/Config.in"
source "package/thirdparty/kodi-audioencoder-wav/Config.in"
source "package/thirdparty/kodi-addon-xvdr/Config.in"
source "package/thirdparty/kodi-platform/Config.in"
source "package/thirdparty/kodi-pvr-argustv/Config.in"
source "package/thirdparty/kodi-pvr-dvblink/Config.in"
source "package/thirdparty/kodi-pvr-dvbviewer/Config.in"
source "package/thirdparty/kodi-pvr-filmon/Config.in"
source "package/thirdparty/kodi-pvr-hts/Config.in"
source "package/thirdparty/kodi-pvr-iptvsimple/Config.in"
source "package/thirdparty/kodi-pvr-mediaportal-tvserver/Config.in"
source "package/thirdparty/kodi-pvr-mythtv/Config.in"
source "package/thirdparty/kodi-pvr-nextpvr/Config.in"
source "package/thirdparty/kodi-pvr-njoy/Config.in"
source "package/thirdparty/kodi-pvr-pctv/Config.in"
source "package/thirdparty/kodi-pvr-stalker/Config.in"
source "package/thirdparty/kodi-pvr-vbox/Config.in"
source "package/thirdparty/kodi-pvr-vuplus/Config.in"
source "package/thirdparty/kodi-pvr-wmc/Config.in"
source "package/thirdparty/kodi-visualisation-spectrum/Config.in"
source "package/thirdparty/kodi-visualisation-waveforhue/Config.in"
source "package/thirdparty/kodi-visualisation-waveform/Config.in"
source "package/thirdparty/recovery_reboot/Config.in"
endmenu
```

## package/thirdparty/kodi-addons/Config.in
```kconfig
menu "Kodi addons"
    depends on BR2_PACKAGE_KODI

comment "Kodi services"

source "package/thirdparty/kodi-addons/opensubtitles/Config.in"
source "package/thirdparty/kodi-addons/weather_yahoo/Config.in"

comment "Kodi scripts"

source "package/thirdparty/kodi-addons/nm/Config.in"
source "package/thirdparty/kodi-addons/mt/Config.in"

endmenu
```

## package/thirdparty/kodi-addons/mt/Config.in
```kconfig
config BR2_PACKAGE_KODI_ADDON_MT
    bool "mt"
    help
      Kodi TOFULinux Maintenance Tool Addon
```

## package/thirdparty/kodi-addons/nm/Config.in
```kconfig
config BR2_PACKAGE_KODI_ADDON_NM
    bool "nm"
    help
      Kodi NetworkManager Addon
```

## package/thirdparty/kodi-pvr-hdhomerun/Config.in
```kconfig
config BR2_PACKAGE_KODI_PVR_HDHOMERUN
	bool "kodi-pvr-hdhomerun"
	select BR2_PACKAGE_KODI_PLATFORM
	help
	  HDHOMERUN PVR for Kodi

	  https://github.com/kodi-pvr/pvr.hdhomerun
```

## package/thirdparty/kodi-pvr-vdr-vnsi/Config.in
```kconfig
config BR2_PACKAGE_KODI_PVR_VDR_VNSI
	bool "kodi-pvr-vdr-vnsi"
	select BR2_PACKAGE_KODI_PLATFORM
	help
	  VDR VNSI PVR client addon for Kodi

	  https://github.com/kodi-pvr/pvr.vdr.vnsi
```

## package/thirdparty/libsquish/Config.in
```kconfig
config BR2_PACKAGE_LIBSQUISH
	bool "libsquish"
	depends on BR2_INSTALL_LIBSTDCPP
	help
	  The squish library (abbreviated to libsquish) is an open source DXT
	  compression library written in C++

	  https://code.google.com/p/libsquish
```
